## Kconfig
```kconfig
# SPDX-License-Identifier: GPL-2.0

menuconfig DEVICE_MODULES
	bool "Support for compiling out-of-tree modules within the kernel tree"
	help
	  Say Y if you want to compile the drivers within this device-modules folder.

if DEVICE_MODULES

endif # DEVICE_MODULES
```

## drivers/google-modules/Kconfig
```kconfig
# SPDX-License-Identifier: GPL-2.0

menuconfig GOOGLE_MODULES
	bool "Support for compiling out-of-tree modules within the kernel tree"
	help
	  Say Y if you want to compile the drivers within this google-modules folder.

if GOOGLE_MODULES

source "drivers/google-modules/amplifiers/audiometrics/Kconfig"
source "drivers/google-modules/amplifiers/cs35l41/Kconfig"
source "drivers/google-modules/amplifiers/cs40l25/Kconfig"
source "drivers/google-modules/amplifiers/drv2624/Kconfig"
source "drivers/google-modules/aoc/Kconfig"
source "drivers/google-modules/bluetooth/broadcom/Kconfig"
source "drivers/google-modules/bms/Kconfig"
source "drivers/google-modules/display/samsung/Kconfig"
source "drivers/google-modules/edgetpu/drivers/edgetpu/Kconfig"
source "drivers/google-modules/fingerprint/fpc/Kconfig"
source "drivers/google-modules/gpu/mali_kbase/Kconfig"
source "drivers/google-modules/gpu/mali_kbase/arbitration/Kconfig"
source "drivers/google-modules/gpu/mali_kbase/platform/pixel/Kconfig"
source "drivers/google-modules/gpu/mali_kbase/tests/Kconfig"
source "drivers/google-modules/gpu/mali_pixel/Kconfig"
source "drivers/google-modules/lwis/Kconfig"
source "drivers/google-modules/nfc/Kconfig"
source "drivers/google-modules/power/reset/Kconfig"
source "drivers/google-modules/touch/common/Kconfig"
source "drivers/google-modules/touch/fts_touch/ftm5/Kconfig"
source "drivers/google-modules/touch/sec_touch/Kconfig"
source "drivers/google-modules/uwb/kernel/Kconfig"

endif # GOOGLE_MODULES
```

## drivers/google-modules/amplifiers/audiometrics/Kconfig
```kconfig
# SPDX-License-Identifier: GPL-2.0

comment "Amplifiers"

config AUDIOMETRICS
	tristate "Google Audio Metrics"
```

## drivers/google-modules/amplifiers/cs35l41/Kconfig
```kconfig
config SND_SOC_CS35L41
        tristate "Cirrus Logic CS35L41 CODEC"
        select SND_SOC_WM_ADSP_GS

config SND_SOC_CS35L41_SPI
	tristate "Cirrus Logic CS35L41 CODEC (SPI)"
	depends on SPI_MASTER
	default y if SOC_GS101
	select SND_SOC_CS35L41
	select REGMAP_SPI

config SND_SOC_CS35L41_I2C
	tristate "Cirrus Logic CS35L41 CODEC (I2C)"
	depends on I2C
	default y if SOC_GS101
	select SND_SOC_CS35L41
	select REGMAP_I2C

config SND_SOC_WM_ADSP_GS
	tristate
	select SND_SOC_COMPRESS
```

## drivers/google-modules/aoc/Kconfig
```kconfig
#
# AoC Driver Support
#

comment "AoC"

config WC_MBOX
	tristate "Whitechapel Mailbox support"
	depends on MAILBOX
	default y if SOC_GS101
	help
		Say yes here to build the generic mailbox driver for the exynos
		mailboxes in Whitechapel

config AOC_DRIVER
	tristate "WhiteChapel AoC support"
	default n
	depends on WC_MBOX
	help
		Say yes here to add support for the AoC subsystem in WhiteChapel

config AOC_CHAR_DRIVER
	tristate "WhiteChapel AoC character device support"
	default y if AOC_DRIVER
	help
		Say yes here to expose AoC services as character devices

config AOC_CHAN_DRIVER
	tristate "WhiteChapel AoC IPC channel support"
	default y if AOC_DRIVER
	help
		Say yes here to add channelized IPC support for USF

config AOC_CONTROL_DRIVER
	tristate "WhiteChapel AoC Basic Control"
	default y if AOC_DRIVER
	help
		Say yes here to add basic control for the AoC

config AOC_UWB_DRIVER
	tristate "WhiteChapel AoC UWB support"
	default y if AOC_DRIVER
	help
		Say yes here to add basic UWB support for the AoC
```

## drivers/google-modules/bluetooth/broadcom/Kconfig
```kconfig
config NITROUS
	tristate "Bluetooth power management driver"
	default n
	help
		Say yes here to build the Nitrous Bluetooth power management
		driver
```

## drivers/google-modules/display/samsung/Kconfig
```kconfig
config DRM_SAMSUNG
	tristate "DRM Support for Samsung EXYNOS Series"
	depends on OF && DRM && (SOC_EXYNOS9820 || SOC_GS101) && ION
	select DRM_KMS_HELPER
	select VIDEOMODE_HELPERS
	help
	  Choose this option if you have a Samsung EXYNOS SoC chipset.
	  If M is selected the module will be called exynosdrm. It will
	  control various panel drivers and display hardware on Samsung
	  Exynos SoC chipset.

if DRM_SAMSUNG

config DRM_SAMSUNG_DPP
	bool "DPP on Exynos"
	default DRM_SAMSUNG
	depends on DRM_SAMSUNG
	help
	  This enables support for DPP(Display Pre Processor) device on
	  Samsung Exynos SoC. It will support scaling, rotation, compression
	  and so on.

comment "CRTCs"

config DRM_SAMSUNG_DECON
	bool "DECON on Exynos"
	depends on !FB_S3C && !DRM_EXYNOS
	default DRM_SAMSUNG
	help
	  Choose this option if you want to use Exynos DECON for DRM. It
	  will control DECON hardware. It can blend all windows connected
	  to DPP.

comment "Encoders and Bridges"

config DRM_SAMSUNG_DSI
	bool "MIPI-DSI host"
	depends on DRM_SAMSUNG_DECON
	select DRM_MIPI_DSI
	select DRM_PANEL
	default DRM_SAMSUNG
	help
	  This enables support for Exynos MIPI-DSI device. It will encode
	  data as mipi standard and transfer to the mipi panel. It also
	  supports to read and write mipi command to and from the mipi panel.
	  So, this driver can use various panel feature.

config DRM_SAMSUNG_WB
	bool "WB on Exynos"
	depends on DRM_SAMSUNG_DECON
	default DRM_SAMSUNG
	help
	  This enables support for Exynos Concurrent Writeback device.
	  It can be attached writeback at runtime. It will dump blended
	  output buffer which is displaying on LCD.
	  This means that both writeback and LCD display can be operated
	  simultaneously.

endif

config DRM_PANEL_SAMSUNG_COMMON
	tristate "Samsung Common panel"

config DRM_PANEL_SAMSUNG_EMUL
	tristate "Samsung EMUL DSI command mode panel"
	depends on DRM_PANEL_SAMSUNG_COMMON
	help
	  This driver supports virtual panel on samsung emulator. It just
	  supports to turn on and off the virtual panel. Also if proper
	  panel driver couldn't be found, it can be chosen.

config DRM_PANEL_SAMSUNG_S6E3HC2
	tristate "Samsung S6E3HC2 DSI command mode panel"
	depends on DRM_PANEL_SAMSUNG_COMMON
	help
	  This driver supports S6E3HC2 panel on samsung SoC. It supports
	  to turn on and off the S6E3HC2 panel and it can also supports
	  panel specific features.

config DRM_PANEL_SAMSUNG_S6E3FC3
	tristate "Samsung S6E3FC3 DSI command mode panel"
	depends on DRM_PANEL_SAMSUNG_COMMON
	help
	  This driver supports S6E3FC3 panel on samsung SoC. It supports
	  to turn on and off the S6E3FC3 panel and it can also supports
	  panel specific features.

config DRM_PANEL_SAMSUNG_SOFEF01
	tristate "Samsung SOFEF01 DSI command mode panel"
	depends on DRM_PANEL_SAMSUNG_COMMON
	help
	  This driver supports SOFEF01 panel on samsung SoC. It supports
	  to turn on and off the SOFEF01 panel and it can also supports
	  panel specific features.

config DRM_PANEL_SAMSUNG_S6E3HC3
	tristate "Samsung S6E3HC3 DSI command mode panel"
	depends on DRM_PANEL_SAMSUNG_COMMON
	help
	  This driver supports S6E3HC3 panel on samsung SoC. It supports
	  to turn on and off the S6E3HC3 panel and it can also supports
	  panel specific features.
```

## drivers/google-modules/fingerprint/fpc/Kconfig
```kconfig
#-----------------------------------#
#    Kconfig for FingerprintCard    #
#-----------------------------------#

comment "Fingerprint"

config FPC_FINGERPRINT
	default n
	tristate "fpc1020 fingerprint driver"
```

## drivers/google-modules/lwis/Kconfig
```kconfig
#
# LWIS camera drivers
#

comment "LWIS"

config LWIS
      bool "Drivers under LWIS implementation"
      default n
      help
		    This is the LWIS implementation
```

## drivers/google-modules/nfc/Kconfig
```kconfig
# SPDX-License-Identifier: GPL-2.0-only
#
# Near Field Communication (NFC) devices
#

comment "NFC"

config NFC_ST21NFC
	tristate "ST Microelectronics ST21NFC NFC Controller Driver"
	depends on I2C
	help
	 ST Microelectronics ST21NFC Near Field Communication controller support.

config NFC_ST21NFC_NO_CRYSTAL
	bool "ST Microelectronics ST21NFC NFC Controller Driver, no external crystal"
	depends on NFC_ST21NFC
	default y if SOC_GS101
	help
	 ST Microelectronics ST21NFC Near Field Communication controller support.

config ESE_ST54
	tristate "ST Microelectronics ST54 family ESE driver"
	depends on SPI
	default y if SOC_GS101
	help
	  ST Microelectronics ST54 ESE Near Field Communication controller support.

config ESE_ST33
	tristate "ST Microelectronics ST33 ESE driver"
	depends on SPI
	default y if SOC_GS101
	help
	  ST Microelectronics ST33 ESE Near Field Communication controller support.
```

## drivers/google-modules/uwb/kernel/Kconfig
```kconfig
# SPDX-License-Identifier: GPL-2.0

comment "UWB"

menuconfig QORVO_UWB
	bool "Qorvo UWB stack for linux"

config MCPS_FAKE
	tristate "Stubbed MCPS802154 driver"

config MCPS802154_TESTMODE
	tristate "MCPS802154 testmode driver"
	default y if SOC_GS101

config QCOM_SPI_LOWLATENCY
	tristate "Qualcomm low-latency SPI driver"
```

## drivers/scsi/ufs/Kconfig
```kconfig
# SPDX-License-Identifier: GPL-2.0-only

config SCSI_UFS_EXYNOS_GS
	tristate "EXYNOS UFS Host Controller Driver for GS SoCs"
	depends on SCSI_UFSHCD && SCSI_UFSHCD_PLATFORM
	help
	  This selects the GS UFS host controller driver which
	  run with GS SoCs.

	  If you have a controller with this interface, say Y or M here.
```
